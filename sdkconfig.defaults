## sdkconfig.defaults
```kconfig
# Enable PPP over Serial (works across IDF 4.x/5.x)
CONFIG_PPP_SUPPORT=y
CONFIG_LWIP_PPP_SUPPORT=y

# Common PPP authentication methods
CONFIG_LWIP_PPP_PAP_SUPPORT=y
CONFIG_LWIP_PPP_CHAP_SUPPORT=y
CONFIG_LWIP_PPP_MSCHAP_SUPPORT=y
CONFIG_LWIP_PPP_MPPE_SUPPORT=n

# Recommended: use peer DNS provided by the modem
CONFIG_LWIP_DNS_SUPPORT_MDNS_QUERIES=y
```
